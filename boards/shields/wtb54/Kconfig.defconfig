## boards/shields/wtb54/Kconfig.defconfig
```kconfig
if SHIELD_WTB54_RIGHT

config ZMK_KEYBOARD_NAME
    default "wtb54"

endif

if SHIELD_WTB54_LEFT || SHIELD_WTB54_RIGHT

config ZMK_SPLIT
    default y

endif
```

## boards/shields/wtb54/Kconfig.shield
```kconfig
config SHIELD_WTB54_LEFT
    def_bool $(shields_list_contains,wtb54_left)
config SHIELD_WTB54_RIGHT
    def_bool $(shields_list_contains,wtb54_right)
```

## config/west.yml
```yaml
manifest:
  remotes:
    - name: zmkfirmware
      url-base: https://github.com/zmkfirmware
    - name: sekigon-gonnoc
      url-base: https://github.com/sekigon-gonnoc
  projects:
    - name: zmk
      remote: zmkfirmware
      revision: e34793e  # 2024年11月時点で動作確認済み
      import: app/west.yml
    - name: zmk-driver-paw3222
      remote: sekigon-gonnoc
      revision: 9daf613  # ドライバーも固定
  self:
    path: config
```
